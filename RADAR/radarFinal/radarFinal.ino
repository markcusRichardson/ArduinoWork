#include <radar.h>

#include <SoftwareSerial.h>
SoftwareSerial SSerial(11, 10); // RX, TX
 #define Serial1 SSerial

#define MESSAGE_HEAD 0x55

byte radarResponse[9];
const int responseLength = 9;


 void setup(){
  Serial.begin(9600);
  Serial1.begin(9600);
  Serial.print("Initialized");
  sendMotionQuery();
  sendSensitiveQuery();
  sendSceneQuery();
 }

 void loop(){
  
  
  if (Serial1.available() >= responseLength) {
    readRadarResponse();
    interpretResponse();
  }
 }


void readRadarResponse() {
  // Look for the start of a valid frame
  while (Serial1.available()) {
    byte incomingByte = Serial1.read();

    // Check if we have found the frame header
    if (incomingByte == 0x55) {
      // Once we find the frame header, read the rest of the frame
      radarResponse[0] = incomingByte; // Save the header
      for (int i = 1; i < responseLength; i++) {
        // Ensure enough bytes are available before reading
        while (!Serial1.available());
        radarResponse[i] = Serial1.read();
      }

      // Debug: Print the full frame
      Serial.print("Radar Response: ");
      for (int i = 0; i < responseLength; i++) {
        Serial.print("0x");
        Serial.print(radarResponse[i], HEX);
        Serial.print(" ");
      }
      Serial.println();

      // Exit once we have a complete frame
      return;
    }
  }
}



void interpretResponse() {
  // Verify the header and function code
  if (radarResponse[0] == 0x55 ) {
    byte motionState = radarResponse[8]; // 6th byte contains motion state
    switch (motionState) {
      case 0x02:
        Serial.println("Approaching Detected.");
        break;
      case 0x03:
        Serial.println("Departing Detected.");
        break;
      case 0x04:
        Serial.println("Sustained approach.");
        break;
      case 0x05:
        Serial.println("Sustained away.");
        break;
      default:
        
        break;
    }
  } else {
    Serial.println("Invalid Response.");
  }
}
 void sendMotionQuery() {
  byte queryFrame[] = {0x55, 0x07, 0x00, 0x01, 0x03, 0x07, 0x00, 0x00}; 
  unsigned short crc = calculateCRC16(queryFrame, sizeof(queryFrame) - 2);
  queryFrame[sizeof(queryFrame) - 2] = (crc & 0xFF);
  queryFrame[sizeof(queryFrame) - 1] = (crc >> 8);

  Serial1.write(queryFrame, sizeof(queryFrame));
  
}

void sendSceneQuery(){
  byte queryFrame1[] = {0x55, 0x08, 0x00, 0x02, 0x04, 0x10, 0x01, 0x00, 0x00};
  unsigned short crc1 = calculateCRC16(queryFrame1, sizeof(queryFrame1) -2);
  queryFrame1[sizeof(queryFrame1) - 2] = (crc1 & 0XFF);
  queryFrame1[sizeof(queryFrame1) - 1] = (crc1 >> 8);

  Serial1.write(queryFrame1, sizeof(queryFrame1));


}

void sendSensitiveQuery(){
  byte queryFrame2[] = {0x55, 0x08, 0x00, 0x02, 0x04, 0x0C, 0x03, 0x00, 0x00};
  unsigned short crc2 = calculateCRC16(queryFrame2, sizeof(queryFrame2) -2);
  queryFrame2[sizeof(queryFrame2) - 2] = (crc2 & 0XFF);
  queryFrame2[sizeof(queryFrame2) - 1] = (crc2 >> 8);

  Serial1.write(queryFrame2, sizeof(queryFrame2));


}


const unsigned char cuc_CRCHi[256]=
{
0x00, 0xC1, 0x81, 0x40, 0x01, 0xC0, 0x80, 0x41, 0x01, 0xC0, 0x80, 0x41,
0x00, 0xC1, 0x81, 0x40, 0x01, 0xC0, 0x80, 0x41, 0x00, 0xC1, 0x81, 0x40,
0x00, 0xC1, 0x81, 0x40, 0x01, 0xC0, 0x80, 0x41, 0x01, 0xC0, 0x80, 0x41,
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0x00, 0xC1, 0x81, 0x40
};

const unsigned char cuc_CRCLo[256]=
{
0x00, 0xC0, 0xC1, 0x01, 0xC3, 0x03, 0x02, 0xC2, 0xC6, 0x06, 0x07, 0xC7,
0x05, 0xC5, 0xC4, 0x04, 0xCC, 0x0C, 0x0D, 0xCD, 0x0F, 0xCF, 0xCE, 0x0E,
0x0A, 0xCA, 0xCB, 0x0B, 0xC9, 0x09, 0x08, 0xC8, 0xD8, 0x18, 0x19, 0xD9,
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0x41, 0x81, 0x80, 0x40
};

unsigned short calculateCRC16(byte *frame, unsigned short length) {
  unsigned char crcHi = 0xFF;
  unsigned char crcLo = 0xFF;
  unsigned int index;

  while (length--) {
    index = crcLo ^ *frame++;
    crcLo = crcHi ^ cuc_CRCHi[index];
    crcHi = cuc_CRCLo[index];
  }

  return (crcLo << 8 | crcHi);
}